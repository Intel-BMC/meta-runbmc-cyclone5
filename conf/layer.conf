## conf/layer.conf
```bitbake
LOCALCONF_VERSION = "1"
# We have a conf and classes directory, add to BBPATH
BBPATH .= ":${LAYERDIR}"

# We have recipes-* directories, add to BBFILES
BBFILES += "${LAYERDIR}/recipes-*/*/*.bb \
            ${LAYERDIR}/recipes-*/*/*.bbappend"

BBFILE_COLLECTIONS += "runbmc-cyclone5"
BBFILE_PATTERN_runbmc-cyclone5 = "^${LAYERDIR}/"
BBFILE_PRIORITY_runbmc-cyclone5 = "11"
LAYERSERIES_COMPAT_runbmc-cyclone5 = "honister kirkstone langdale"

LAYERDEPENDS_runbmc-cyclone5 = "meta-intel-fpga"
# meta-intel-fpga tested to be backward compatible
LAYERSERIES_COMPAT_meta-intel-fpga:append := " honister kirkstone langdale"

INHERIT += "extrausers"
#INHERIT += " cve-check"

EXTRA_USERS_PARAMS:append:pn-intel-platforms = " \
${@bb.utils.contains('EXTRA_IMAGE_FEATURES', 'debug-tweaks', "usermod -p '\$1\$UGMqyqdG\$FZiylVFmRRfl9Z0Ue8G7e/' root;", '', d)}"

hostname:pn-base-files = "intel-obmc"
```

## conf/machine/runbmc-cyclone5.conf
```bitbake
KMACHINE = "cyclone5"

PREFERRED_VERSION_u-boot-socfpga ?= "v2023.01%"
UBOOT_CONFIG = ""
UBOOT_MACHINE = "socfpga_cyclone5_runbmc_defconfig"

UBOOT_SUFFIX="img"
UBOOT_BINARY="u-boot.${UBOOT_SUFFIX}"

KERNEL_PROVIDER ?= "linux-socfpga-lts"
PREFERRED_VERSION_linux-socfpga-lts ?= "6.1.20%"
KERNEL_DEVICETREE ?= "cyclone5_runbmc.dtb"

KERNEL_CLASSES ?= "kernel-fitimage"
KERNEL_IMAGETYPE ?= "fitImage"

IMAGE_BOOT_FILES ?= "fitImage-${INITRAMFS_IMAGE}-${MACHINE}-${MACHINE};fitImage"

WKS_FILE ?= "runbmc-cyclone5.wks"

IMAGE_FSTYPES ?= "squashfs-xz wic.xz"

MMC_BOOT_PARTITION_SIZE ?="32768"

require conf/machine/include/socfpga.inc
require conf/machine/include/intel.inc

# includes enabling OpenBMC eMMC as boot memory
require conf/distro/include/phosphor-mmc.inc
require conf/machine/include/obmc-bsp-common.inc

UBOOT_ENTRYPOINT = "0x1000000"
UBOOT_LOADADDRESS = "0x1000000"
```

## wic/runbmc-cyclone5.wks
```
# short-description: Create MMC OpenBMC image for Intel RunBMC module
# long-description: Create MMC OpenBMC image for Intel RunBMC module based on CycloneV SoC

# Partition layout:
#  1) 128kB reserved for u-boot-env, aligned to GPT size
#  2) 32MB  boot-a (kernel)
#  3) 32MB  boot-b (kernel)
#  4) 512MB rofs-a (read-only rootfs)
#  5) 512MB rofs-b (read-only rootfs)
#  6) -     rwfs   (persistent data, extended to end of storage at first boot)
#
#  u-boot is not included in this image and shall be on 1st eMMC boot partition

bootloader --ptable gpt

part --ondisk mmcblk --label env --fixed-size 128k
part --source bootimg-partition --ondisk mmcblk --fstype=ext4 --label boot-a --active --fixed-size 32M
part --source bootimg-partition --ondisk mmcblk --fstype=ext4 --label boot-b --active --fixed-size 32M
part --source rootfs --ondisk mmcblk --fstype=ext4 --label rofs-a --fixed-size 512M
part --source rootfs --ondisk mmcblk --fstype=ext4 --label rofs-b --fixed-size 512M
part --fstype=ext4 --label rwfs --fixed-size 100M
```
